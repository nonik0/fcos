// This file implements characters as lines of code within pixels.hpp
// It is not meant to be included elsewhere.

// clang-format off
#define CHAR3X4(c, ...) (character == c) { charData = { __VA_ARGS__ }; }
if CHAR3X4('0',
        1, 1, 1,
        1, 0, 1,
        1, 0, 1,
        1, 1, 1)
else if CHAR3X4('1',
        0, 1, 0,
        0, 1, 0,
        0, 1, 0,
        0, 1, 0)
else if CHAR3X4('2',
        1, 1, 1,
        0, 0, 1,
        1, 1, 0,
        1, 1, 1)
else if CHAR3X4('3',
        1, 1, 1,
        0, 0, 1,
        0, 1, 1,
        1, 1, 1)
else if CHAR3X4('4',
        1, 0, 1,
        1, 0, 1,
        1, 1, 1,
        0, 0, 1)
else if CHAR3X4('5',
        1, 1, 1,
        1, 1, 0,
        0, 0, 1,
        1, 1, 1)
else if CHAR3X4('6',
        0, 1, 1,
        1, 0, 0,
        1, 1, 1,
        1, 1, 1)
else if CHAR3X4('7',
        1, 1, 1,
        0, 0, 1,
        0, 1, 0,
        0, 1, 0)
else if CHAR3X4('8',
        1, 1, 1,
        1, 1, 1,
        1, 0, 1,
        1, 1, 1)
else if CHAR3X4('9',
        1, 1, 1,
        1, 1, 1,
        0, 0, 1,
        1, 1, 0)
else if CHAR3X4('F',
        1, 1, 1,
        1, 1, 0,
        1, 0, 0,
        1, 0, 0)
else if CHAR3X4('%',
        1, 0, 0, 1,
        0, 0, 1, 0,
        0, 1, 0, 0,
        1, 0, 0, 1)
else if CHAR3X4('*',
        1, 1,
        1, 1,
        0, 0,
        0, 0)
else if CHAR3X4('Q',
        0, 1, 1, 0,
        1, 0, 0, 1,
        1, 0, 1, 1,
        0, 1, 1, 1)
else if CHAR3X4(':',
        0, 0, 0,
        0, 1, 0,
        0, 0, 0,
        0, 1, 0)
else if CHAR3X4(' ',
        0, 0, 0,
        0, 0, 0,
        0, 0, 0,
        0, 0, 0)